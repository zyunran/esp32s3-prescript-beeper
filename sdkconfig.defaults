## sdkconfig.defaults
```kconfig
# 芯片必须显式: 否则全新 clone 会编成 esp32
CONFIG_IDF_TARGET="esp32s3"

# 自定义分区: ota_0/ota_1 各 2MB
CONFIG_PARTITION_TABLE_CUSTOM=y
CONFIG_PARTITION_TABLE_CUSTOM_FILENAME="partitions.csv"

# 16MB 闪存 + DIO/80MHz
CONFIG_ESPTOOLPY_FLASHMODE_DIO=y
CONFIG_ESPTOOLPY_FLASHFREQ_80M=y
CONFIG_ESPTOOLPY_FLASHSIZE_16MB=y

# SNTP: 3 服务器; 校时失败 10 分钟重试
CONFIG_LWIP_SNTP_MAX_SERVERS=3
CONFIG_LWIP_SNTP_UPDATE_DELAY=600000

# OTA 回滚
CONFIG_BOOTLOADER_APP_ROLLBACK_ENABLE=y
CONFIG_BOOTLOADER_APP_ANTI_ROLLBACK=n
```
